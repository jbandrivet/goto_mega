/*
 * GotoMega - Teensy 4.1 Raquette
 * Auteur : Andrivet Jean-Baptiste
 * Firmware UI (LCD + boutons)
 * 
 * Cablage RJ11 (Teensy raquette <-> Mega) :
 *
 *   Pin RJ11   Signal                    Connexion
 *   -------    ------                    ---------
 *     1        GND                       Mega GND  <-> Teensy GND
 *     2        5V  (alim Teensy)         Mega 5V    -> Teensy VIN
 *     3        TX  (Teensy -> Mega)      Teensy Pin 1 (TX1) -> Mega Pin 15 (RX3)
 *     4        RX  (Mega -> Teensy)      Mega Pin 14 (TX3)  -> Teensy Pin 0 (RX1)
 *
 * ALIMENTATION : Le Teensy est alimente par la pin 5V du Mega via VIN.
 *   Le Mega doit etre alimente par barrel jack (7-12V) pour fournir
 *   assez de courant (regulateur ~800mA, conso totale ~250mA).
 *   ATTENTION : ne pas brancher l'USB du Teensy en meme temps que le
 *   VIN est alimente, sauf si le pad VUSB est coupe sur le Teensy.
 */

#include <Arduino.h>
#include <Wire.h>
#include <LiquidCrystal_I2C.h>
#include <EEPROM.h>
#include "mini_ephem.h"

enum CatID { CAT_MESSIER=0, CAT_NGC, CAT_IC, CAT_PK, CAT_CALDWELL, CAT_BSC, CAT_SYSSOL, CAT_COUNT };
bool isEnglish = false;
bool displayRaDec = true;
bool temp_displayRaDec = true;
#define CHAR_LEFT  0x7F
#define CHAR_RIGHT 0x7E

int dt_y=2026, dt_m=1, dt_d=1;
int dt_hr=12, dt_min=0, dt_sec=0;
float obs_lat=45.0, obs_lon=0.0;
bool timeFetched = false;

// ============================================================
// SECTION CATALOGUES ASTRONOMIQUES (intégrés en PROGMEM)
// ============================================================

#define OBJ_GALAXY       0
#define OBJ_OPEN_CLUSTER 1
#define OBJ_GLOB_CLUSTER 2
#define OBJ_NEBULA       3
#define OBJ_PLAN_NEBULA  4
#define OBJ_SUPERNOVA    5
#define OBJ_DOUBLE_STAR  6
#define OBJ_ASTERISM     7
#define OBJ_STAR         8

struct DeepSkyObject {
    uint16_t id;
    float    ra;    
    float    dec;   
    int16_t  mag;   
    uint8_t  type;
};

struct StarObject {
    uint16_t id;
    float    ra;
    float    dec;
    int16_t  mag;   
    uint8_t  type;  
    char     name[12];
};

const char* const typeGal = "Galaxie     ";
const char typeOC[]  PROGMEM = "Amas ouvert ";
const char typeGC[]  PROGMEM = "Amas globul.";
const char* const typeNeb = "Nebuleuse   ";
const char typePN[]  PROGMEM = "Neb.Planet. ";
const char typeSN[]  PROGMEM = "Reste SNova ";
const char typeDS[]  PROGMEM = "Etoile dble ";
const char* const typeAst = "Asterisme   ";
const char typeStar[] PROGMEM= "Etoile      ";

const char* const OBJ_TYPE_NAMES[] = {
    typeGal, typeOC, typeGC, typeNeb, typePN, typeSN, typeDS, typeAst, typeStar
};

const char* getTypeName(uint8_t type) {
    if (type >= 9) type = 0;
    if (isEnglish) {
        const char* const OBJ_TYPE_NAMES_EN[] = {
            "Galaxy      ", "Open Cluster", "Glob.Cluster", "Nebula      ", "Plan.Nebula ", "Supernova R.", "Double Star ", "Asterism    ", "Star        "
        };
        return OBJ_TYPE_NAMES_EN[type];
    }
    return OBJ_TYPE_NAMES[type];
}

// ---------- M 110 objets ----------
const DeepSkyObject catalogM[] PROGMEM = {
    {    1,    5.5756f,   22.0144f,   85, 5},
    {    2,   21.5575f,   -0.8233f,   63, 2},
    {    3,   13.7031f,   28.3756f,   62, 2},
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    {  110,    0.6728f,   41.6853f,   81, 0},
};
const uint16_t MESSIER_COUNT = 110;

// ---------- NGC 521 objets ----------
const DeepSkyObject catalogNGC[] PROGMEM = {
    {   55,    0.2483f,  -39.1970f,   80, 0},
    {  147,    0.5508f,   48.5080f,  102, 0},
    {  185,    0.6492f,   48.3370f,   99, 0},
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    { 7662,   23.4375f,   42.5500f,   87, 4},
};
const uint16_t NGC_COUNT = 521;

// ---------- IC 45 objets ----------
const DeepSkyObject catalogIC[] PROGMEM = {
    {  289,    0.9225f,   61.0830f,  124, 4},
    {  342,    3.7750f,   68.1000f,   90, 0},
    {  356,    3.9500f,   69.3670f,  110, 0},
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    { 4221,   12.1950f,   65.0500f,  122, 0},
};
const uint16_t IC_COUNT = 45;

// ---------- PK 50 objets ----------
const DeepSkyObject catalogPK[] PROGMEM = {
    {    1,   17.9775f,   66.6330f,   88, 4},
    {    2,   10.4067f,  -18.6330f,   86, 4},
    {    3,   21.0692f,  -11.3670f,   80, 4},
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    {   50,   19.7000f,   -1.5170f,  103, 4},
};
const uint16_t PK_COUNT = 50;

// ---------- Caldwell 109 objets ----------
const DeepSkyObject catalogCaldwell[] PROGMEM = {
    {    1,   22.0167f,   57.9830f,   79, 1},
    {    2,    0.7658f,   85.3330f,  109, 0},
    {    3,    0.4458f,   61.2170f,  108, 4},
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    {  109,   10.4250f,  -59.0830f,   57, 1},
};
const uint16_t CALDWELL_COUNT = 109;

// ---------- BSC 105 objets ----------
const StarObject catalogBSC[] PROGMEM = {
    {  677,    1.3791f,  -57.2370f,  -12, OBJ_STAR, "Achernar"},
    { 5056,   13.7923f,  -49.2200f,  -11, OBJ_STAR, "Toliman"},
    { 5459,   14.6636f,  -60.8350f,   -3, OBJ_STAR, "Rigil Kent"},
    { 7001,   18.6157f,   38.7810f,    0, OBJ_STAR, "Vega"},
    { 1708,    5.2423f,  -52.6950f,    4, OBJ_STAR, "Canopus"},
    { 2061,    5.5955f,  -11.2020f,    2, OBJ_STAR, "Rigel"},
    { 2099,    5.9195f,   44.9470f,   10, OBJ_STAR, "Capella"},
    { 2693,    7.6554f,   22.0030f,   10, OBJ_STAR, "Pollux"},
    { 2421,    6.7525f,  -16.7130f,   12, OBJ_STAR, "Sirius"},
    { 1457,    4.5989f,   16.5090f,   13, OBJ_STAR, "Aldebaran"},
    { 5191,   13.4232f,  -11.1610f,   10, OBJ_STAR, "Spica"},
    { 5793,   15.2345f,   -9.3830f,    0, OBJ_STAR, "Arcturus"},
    { 6134,   16.4905f,  -26.4320f,    6, OBJ_STAR, "Antares"},
    { 7557,   19.8458f,    8.8680f,    8, OBJ_STAR, "Altair"},
    { 4731,   12.4436f,  -63.0990f,   13, OBJ_STAR, "Mimosa"},
    { 4730,   12.4431f,  -63.0990f,    8, OBJ_STAR, "Acrux"},
    { 4763,   12.5194f,  -63.0990f,   16, OBJ_STAR, "Gacrux"},
    { 1713,    5.2422f,   45.9990f,    8, OBJ_STAR, "Capella"},
    {  424,    1.4280f,   60.7160f,   13, OBJ_STAR, "Schedar"},
    {  603,    1.9060f,   29.5750f,   20, OBJ_STAR, "Hamal"},
    { 1790,    5.4197f,   28.6070f,   16, OBJ_STAR, "Elnath"},
    { 2990,    7.8546f,   28.0260f,   14, OBJ_STAR, "Castor"},
    { 3165,    9.2500f,  -58.9660f,   19, OBJ_STAR, "Avior"},
    { 3307,   10.1397f,  -58.9660f,   19, OBJ_STAR, "Alsephina"},
    { 4534,   11.9308f,   53.6950f,   22, OBJ_STAR, "Alioth"},
    { 4662,   12.2573f,  -58.7490f,   16, OBJ_STAR, "Miaplacidus"},
    { 4905,   13.0325f,  -78.7090f,   19, OBJ_STAR, "Peacock"},
    { 5054,   13.6647f,   49.3130f,   14, OBJ_STAR, "Alkaid"},
    { 5854,   15.5806f,  -14.7890f,   22, OBJ_STAR, "Zuben"},
    { 6556,   17.5621f,   12.5600f,   20, OBJ_STAR, "Rasalhague"},
    { 6879,   18.3561f,  -26.2990f,   19, OBJ_STAR, "Kaus Aust."},
    { 7121,   18.9360f,   38.7840f,   18, OBJ_STAR, "Vega"},
    { 7796,   20.3906f,   40.2570f,   12, OBJ_STAR, "Deneb"},
    { 8728,   22.9608f,  -29.6220f,   18, OBJ_STAR, "Fomalhaut"},
    {   15,    0.1396f,   29.0910f,   22, OBJ_STAR, "Alpheratz"},
    {   21,    0.1530f,   59.1500f,   24, OBJ_STAR, "Caph"},
    {  168,    0.5548f,   63.6700f,   27, OBJ_STAR, "Ruchbah"},
    {  337,    1.0692f,  -71.9650f,   24, OBJ_STAR, "Ankaa"},
    {  472,    1.5330f,   41.4030f,   22, OBJ_STAR, "Mirach"},
    {  617,    1.9800f,  -40.3050f,   29, OBJ_STAR, "Acamar"},
    {  799,    2.4975f,   89.2640f,   22, OBJ_STAR, "Polaris"},
    {  907,    2.8575f,   55.8950f,   24, OBJ_STAR, "Mirphak"},
    { 1228,    3.9087f,   40.9570f,   28, OBJ_STAR, "Algol"},
    { 1231,    3.9158f,   40.9570f,   24, OBJ_STAR, "Almach"},
    { 1325,    4.2308f,   -3.3540f,   28, OBJ_STAR, "Rigel"},
    { 1409,    4.4258f,   15.9520f,   28, OBJ_STAR, "Ain"},
    { 1412,    4.4264f,   15.6220f,   28, OBJ_STAR, "Alcyone"},
    { 1791,    5.4217f,   28.6070f,   28, OBJ_STAR, "Elnath"},
    { 1820,    5.4780f,   -1.2020f,   26, OBJ_STAR, "Mintaka"},
    { 1852,    5.5336f,   -0.2990f,   23, OBJ_STAR, "Alnilam"},
    { 1862,    5.5543f,   -1.2020f,   22, OBJ_STAR, "Alnitak"},
    { 1903,    5.5953f,   -1.9440f,   24, OBJ_STAR, "Saiph"},
    { 1948,    5.6316f,   -1.9440f,   24, OBJ_STAR, "Trapeze"},
    { 2004,    5.7941f,    7.4070f,   20, OBJ_STAR, "Betelgeuse"},
    { 2294,    6.3758f,   22.5130f,   28, OBJ_STAR, "Alhena"},
    { 2890,    7.5770f,   31.8880f,   15, OBJ_STAR, "Alhena"},
    { 3734,   11.2513f,  -58.7490f,   19, OBJ_STAR, "Eta Car"},
    { 3748,   11.3023f,   20.5240f,   21, OBJ_STAR, "Denebola"},
    { 4057,   12.2694f,  -63.0990f,   20, OBJ_STAR, "Delta Cru"},
    { 4199,   12.5194f,  -57.1130f,   26, OBJ_STAR, "Muhlifain"},
    { 4540,   11.9978f,   14.5720f,   20, OBJ_STAR, "Cor Caroli"},
    { 4786,   12.6939f,  -48.9600f,   23, OBJ_STAR, "Menkent"},
    { 5019,   13.5991f,  -57.1130f,   23, OBJ_STAR, "Hadar"},
    { 5165,   13.6647f,  -53.4660f,   23, OBJ_STAR, "Theta Cen"},
    { 5469,   14.7062f,  -27.0960f,   23, OBJ_STAR, "Zubenelg."},
    { 5531,   14.8454f,   74.1560f,   26, OBJ_STAR, "Kocab"},
    { 5563,   14.9444f,   74.1560f,   22, OBJ_STAR, "Dubhe"},
    { 6212,   16.6179f,  -34.2930f,   24, OBJ_STAR, "Graffias"},
    { 6527,   17.5086f,  -37.1040f,   22, OBJ_STAR, "Shaula"},
    { 6553,   17.5621f,  -12.5600f,   20, OBJ_STAR, "Sabik"},
    { 6588,   17.6222f,  -42.9970f,   27, OBJ_STAR, "Lesath"},
    { 6714,   17.9473f,   51.4890f,   28, OBJ_STAR, "Etamin"},
    { 6746,   18.0097f,  -30.4240f,   28, OBJ_STAR, "Kaus Med."},
    { 6869,   18.3492f,  -26.2990f,   20, OBJ_STAR, "Kaus Aus."},
    { 7106,   18.9218f,   26.8690f,   28, OBJ_STAR, "Sheliak"},
    { 7525,   19.7705f,   10.6150f,   21, OBJ_STAR, "Tarazed"},
    { 7924,   20.6904f,   45.2800f,   21, OBJ_STAR, "Sadr"},
    { 8425,   22.0961f,   -6.7230f,   25, OBJ_STAR, "Sadalsuud"},
    { 8597,   22.4881f,  -30.8950f,   27, OBJ_STAR, "Sadalmelik"},
    { 8636,   22.5836f,  -28.4530f,   22, OBJ_STAR, "Sadalbari"},
    { 8775,   23.0629f,   28.0830f,   26, OBJ_STAR, "Algenib"},
    { 8832,   23.2108f,   14.2200f,   29, OBJ_STAR, "Markab"},
    {  188,    0.6425f,   56.5370f,   24, OBJ_STAR, "Shedar"},
    {  264,    0.8553f,  -14.5400f,   28, OBJ_STAR, "Difda"},
    {  526,    1.6279f,  -10.1820f,   29, OBJ_STAR, "Menkar"},
    { 1641,    4.8549f,    6.9610f,   29, OBJ_STAR, "Ain"},
    { 3982,   12.1372f,  -24.7280f,   26, OBJ_STAR, "Algorab"},
    { 4295,   11.0624f,   61.7510f,   26, OBJ_STAR, "Dubhe"},
    { 4301,   11.0624f,   56.3830f,   24, OBJ_STAR, "Merak"},
    { 4359,   11.1622f,   53.6950f,   24, OBJ_STAR, "Phecda"},
    { 4375,   11.0368f,   38.1930f,   29, OBJ_STAR, "Megrez"},
    { 4660,   12.2573f,   57.0330f,   27, OBJ_STAR, "Mizar"},
    { 6148,   16.5151f,  -26.4320f,   29, OBJ_STAR, "Graffias"},
    { 6175,   16.5992f,  -28.2160f,   26, OBJ_STAR, "Pi Sco"},
    { 6241,   16.8360f,  -34.2930f,   23, OBJ_STAR, "Dschubba"},
    { 6670,   17.7931f,  -37.1040f,   28, OBJ_STAR, "Lesath"},
    { 6876,   18.3561f,  -26.2990f,   20, OBJ_STAR, "Kaus Aus."},
    { 7028,   18.8228f,   33.3630f,   21, OBJ_STAR, "Sulafat"},
    { 7178,   19.2128f,   67.6610f,   24, OBJ_STAR, "Rastaban"},
    { 7570,   19.8617f,   21.6880f,   22, OBJ_STAR, "Azel"},
    { 7602,   19.9297f,  -21.0170f,   28, OBJ_STAR, "Nunki"},
    { 7950,   21.0959f,  -11.3720f,   28, OBJ_STAR, "Enif"},
    { 8308,   21.7959f,  -16.1320f,   28, OBJ_STAR, "Sadalsuud"},
    { 8414,   22.0634f,   -0.3190f,   28, OBJ_STAR, "Ancha"},
    { 8634,   22.5800f,   -0.3190f,   24, OBJ_STAR, "Skat"},
};
const uint16_t BSC_COUNT = 105;

// Accès catalogues - Teensy 4.1
DeepSkyObject getObjectFromCatalog(const DeepSkyObject* catalog, uint16_t index) {
    return catalog[index];
}
StarObject getStarFromCatalog(uint16_t index) {
    return catalogBSC[index];
}

// ============================================================
// SECTION 1 : CONFIGURATION
// ============================================================
#define LCD_ADDR   0x27
#define BTN_UP      6
#define BTN_DOWN    7
#define BTN_LEFT    8
#define BTN_RIGHT   9
#define BTN_ENTER  10

#define MEGA_BAUD         38400
#define POLL_INTERVAL_MS   250    
#define TEENSY_TIMEOUT_MS  500    
#define DEBOUNCE_MS         10
#define FAST_SCROLL_DELAY  150    
#define FAST_SCROLL_STEP    10    

// ============================================================
// SECTION 2 : OBJETS GLOBAUX
// ============================================================
LiquidCrystal_I2C lcd(LCD_ADDR, 20, 4);

// ============================================================
// SECTION 3 : ÉTAT MONTURE (mis à jour par polling)
// ============================================================
double  m_currentRA   = 0.0;
double  m_currentDEC  = 0.0;
double  m_currentAlt  = 0.0;
double  m_currentAz   = 0.0;
bool    m_isTracking  = false;
bool    m_isSlewing   = false;
bool    m_limitHit    = false;
bool    m_isParked    = false;
bool    m_isAligned   = false;
bool    m_timeSet     = true;     // sera update via Mega

double  m_slewSpeed   = 2.0;
bool    m_online      = false;
bool    m_isPaused    = false;
double  targetRA      = -1.0;
double  targetDEC     = -1.0;

uint8_t mountType = 0;
String global_gm = "";
float   gearRatioAZ = 750.0;
float   gearRatioALT = 750.0;
bool    buzzerOn = true;
bool    temp_isEnglish = true;
bool    gpsEnabled = true;
bool    temp_gpsEnabled = true;
bool    motorPowerOn = true;
bool    temp_motorPowerOn = true;

double  temp_slewSpeed = 2.0;
uint8_t temp_mountType = 0;
float   temp_gearRatioAZ = 750.0;
float   temp_gearRatioALT = 750.0;
bool    temp_buzzerOn = true;

void loadEEPROM() {
    if(EEPROM.read(0) == 42) {
        // mountType read disabled, from Mega now
        EEPROM.get(2, gearRatioAZ);
        EEPROM.get(6, gearRatioALT);
        buzzerOn = EEPROM.read(10) > 0;
        EEPROM.get(11, m_slewSpeed);
        if(m_slewSpeed < 0.5 || m_slewSpeed > 6.0) m_slewSpeed = 2.0;
        isEnglish = EEPROM.read(15) > 0;
        displayRaDec = EEPROM.read(16) > 0;
    } else {
        EEPROM.write(0, 42);
        EEPROM.write(1, mountType);
        EEPROM.put(2, gearRatioAZ);
        EEPROM.put(6, gearRatioALT);
        EEPROM.write(10, buzzerOn);
        EEPROM.put(11, m_slewSpeed);
        EEPROM.write(15, isEnglish);
        EEPROM.write(16, displayRaDec);
    }
}

void saveEEPROM() {
    // mountType write disabled, handled by Mega
    EEPROM.put(2, gearRatioAZ);
    EEPROM.put(6, gearRatioALT);
    EEPROM.write(10, buzzerOn);
    EEPROM.put(11, m_slewSpeed);
    EEPROM.write(15, isEnglish);
    EEPROM.write(16, displayRaDec);
}

char           uiMsgL0[21] = "";
char           uiMsgL1[21] = "";
unsigned long  uiMsgUntil  = 0;
int            uiMsgReturn = 0;

// ============================================================
// SECTION 4 : ÉTATS UI
// ============================================================
enum UIState {
    UI_MAIN, UI_CAT_SELECT, UI_OBJECT_LIST, UI_OBJECT_INFO,
    UI_SLEWING, UI_SETTINGS, UI_SPEED, UI_ALIGN, UI_PARKING,
    UI_MOUNT, UI_RATIO_AZ, UI_RATIO_ALT, UI_BEEP, UI_OFFLINE,
    UI_MESSAGE, UI_EDIT_TIME, UI_EDIT_LOCATION, UI_MENU_SELECT,
    UI_MOTOR_POWER, UI_LANGUAGE, UI_ALIGN_CENTER, UI_GPS, UI_COORD_MODE
};
UIState uiState = UI_MAIN;
bool isAlignWorkflow = false;
bool isParkingWorkflow = false;

const char* const CAT_NAMES[] = { "Messier","NGC","IC","PK","Caldwell","Etoiles","SysSol  " };

CatID    currentCat  = CAT_MESSIER;
uint32_t objectIndex = 0;

DeepSkyObject selectedObj;
StarObject    selectedStar;
bool          selectedIsStar = false;

int  settingsSel = 0;
int  menuSel = 0;
int  editSel = 0;
bool lcdNeedsRefresh = true;

// ============================================================
// SECTION 5 : BOUTONS
// ============================================================
const uint8_t BTN_PINS[5] = {BTN_UP,BTN_DOWN,BTN_LEFT,BTN_RIGHT,BTN_ENTER};
#define BTN_IDX_UP    0
#define BTN_IDX_DOWN  1
#define BTN_IDX_LEFT  2
#define BTN_IDX_RIGHT 3
#define BTN_IDX_ENTER 4

bool btnPressed[5]  = {};
bool btnWas[5]      = {};
bool btnState[5]    = {};
bool btnPrev[5]     = {};
unsigned long btnTime[5]     = {};
unsigned long btnHoldTime[5] = {};

// ============================================================
// SECTION 6 : CARACTÈRES LCD
// ============================================================
byte charArrowUp[8] = {0b00100,0b01110,0b10101,0b00100,0b00100,0b00100,0b00100,0b00000};
byte charArrowDn[8] = {0b00100,0b00100,0b00100,0b00100,0b10101,0b01110,0b00100,0b00000};
byte charStar[8]    = {0b00100,0b10101,0b01110,0b11111,0b01110,0b10101,0b00100,0b00000};
byte charGalaxy[8]  = {0b00000,0b01110,0b11011,0b10001,0b11011,0b01110,0b00000,0b00000};
byte charGlob[8]    = {0b01110,0b11111,0b11111,0b11111,0b11111,0b11111,0b01110,0b00000};
byte charNebula[8]  = {0b10001,0b01010,0b00100,0b11111,0b00100,0b01010,0b10001,0b00000};
byte charSpeed[8]   = {0b00001,0b00011,0b00111,0b01111,0b00111,0b00011,0b00001,0b00000};
byte charCheck[8]   = {0b00000,0b00001,0b00011,0b10110,0b11100,0b01000,0b00000,0b00000};

#define CHAR_UP     0
#define CHAR_DOWN   1
#define CHAR_STAR   2
#define CHAR_GALAXY 3
#define CHAR_GLOB   4
#define CHAR_NEBULA 5
#define CHAR_SPEED  6
#define CHAR_CHECK  7

void initCustomChars(){
    lcd.createChar(CHAR_UP,    charArrowUp);
    lcd.createChar(CHAR_DOWN,  charArrowDn);
    lcd.createChar(CHAR_STAR,  charStar);
    lcd.createChar(CHAR_GALAXY,charGalaxy);
    lcd.createChar(CHAR_GLOB,  charGlob);
    lcd.createChar(CHAR_NEBULA,charNebula);
    lcd.createChar(CHAR_SPEED, charSpeed);
    lcd.createChar(CHAR_CHECK, charCheck);
}

uint8_t getTypeChar(uint8_t t){
    switch(t){
        case OBJ_GALAXY:       return CHAR_GALAXY;
        case OBJ_OPEN_CLUSTER: return CHAR_STAR;
        case OBJ_GLOB_CLUSTER: return CHAR_GLOB;
        case OBJ_STAR:         return CHAR_STAR;
        default:               return CHAR_NEBULA;
    }
}

// ============================================================
// SECTION 7 : COMMUNICATION
// ============================================================
String mega_cmd(const String &cmd, bool needsReply=true){
    while(Serial1.available()) Serial1.read(); // Flush out-of-sync data
    Serial1.print(cmd);
    Serial1.print('#');
    if(!needsReply) return "";
    String resp="";
    unsigned long t0=millis();
    while(millis()-t0 < TEENSY_TIMEOUT_MS){
        while(Serial1.available()){
            char c=(char)Serial1.read();
            if(c=='#') return resp;
            resp+=c;
            if (cmd.startsWith(":S") && !cmd.startsWith(":SC") && !cmd.startsWith(":SL") && !cmd.startsWith(":SG") && resp.length() == 1) {
                if (resp[0] == '0' || resp[0] == '1') return resp;
            }
            if (cmd == ":MS" && resp == "0") return resp;
            if (cmd == ":Q" && resp == "0") return resp;
        }
    }
    return resp; // Return whatever we received instead of ""!
}

String formatRA(double ra_h){
    char b[10];
    int h=(int)ra_h, m=(int)((ra_h-h)*60.0), s=(int)(((ra_h-h)*60.0-m)*60.0);
    sprintf(b,"%02d:%02d:%02d",h,m,s);
    return String(b);
}
String formatDEC(double dec_d){
    char b[12];
    bool neg=(dec_d<0); dec_d=fabs(dec_d);
    int d=(int)dec_d, m=(int)((dec_d-d)*60.0), s=(int)(((dec_d-d)*60.0-m)*60.0);
    sprintf(b,"%c%02d*%02d:%02d",neg?'-':'+',d,m,s);
    return String(b);
}
double parseRA(const String &s){
    if(s.length()<8) return 0.0;
    return s.substring(0,2).toInt()+s.substring(3,5).toInt()/60.0
          +s.substring(6,8).toInt()/3600.0;
}
double parseDEC_r(const String &s){
    if(s.length()<5) return 0.0;
    bool neg=(s.charAt(0)=='-');
    String t=s.substring(1); t.replace('*',':'); t.replace('\'',':');
    double v=t.substring(0,2).toInt()+t.substring(3,5).toInt()/60.0;
    if(t.length()>=8) v+=t.substring(6,8).toInt()/3600.0;
    return neg?-v:v;
}

void pollMega(){
    String resp=mega_cmd(":GBE");
    if(resp.length()<5){ m_online=false; return; }
    m_online=true;
    int idx=0;
    auto next=[&]()->String{
        int c=resp.indexOf(',',idx);
        String v=(c<0)?resp.substring(idx):resp.substring(idx,c);
        idx=(c<0)?(int)resp.length():c+1;
        return v;
    };
    m_isTracking=next().toInt();
    m_isSlewing =next().toInt();
    if (m_isSlewing) {
        String tra = mega_cmd(":Gr");
        String tdec = mega_cmd(":Gd");
        if (tra.length() >= 8) targetRA = parseRA(tra);
        if (tdec.length() >= 5) targetDEC = parseDEC_r(tdec);
    }
    m_limitHit  =next().toInt();
    m_slewSpeed =next().toInt()/10.0;
    m_currentAlt=next().toFloat();
    m_currentAz =next().toFloat();
    m_isParked  =next().toInt();
    m_isAligned =next().toInt();

    String gu = mega_cmd(":GU");
    if(gu.length() > 0) {
        m_timeSet = (gu.indexOf('F') < 0);
    }

    String ra=mega_cmd(":GR"), dec=mega_cmd(":GD");
    if(ra.length() >=8) m_currentRA =parseRA(ra);
    if(dec.length()>=5) m_currentDEC=parseDEC_r(dec);
    
    String gm = mega_cmd(":GM");
    global_gm = gm;
    if (gm.startsWith("AltAz")) mountType = 0;
    else if (gm.startsWith("ForkEq")) mountType = 1;
    else if (gm.startsWith("GermanEq")) mountType = 2;
}

// ============================================================
// SECTION 8 : COMMANDES VERS MEGA
// ============================================================
void cmd_goto(double ra_h, double dec_d){
    targetRA = ra_h;
    targetDEC = dec_d;
    if (currentCat == CAT_SYSSOL && !selectedIsStar) {
        if (selectedObj.id == 0) mega_cmd(":TS#");
        else if (selectedObj.id == 1) mega_cmd(":TL#");
        else mega_cmd(":TQ#");
    } else {
        mega_cmd(":TQ#");
    }
    mega_cmd(":Sr"+formatRA(ra_h));
    mega_cmd(":Sd"+formatDEC(dec_d));
    String resp=mega_cmd(":MS");
    if(resp.startsWith("0")){
        uiState=UI_SLEWING;
    } else {
        char buf[21]; snprintf(buf,21,"%-20s",resp.c_str());
        showMessage("  !! IMPOSSIBLE !!  ", buf, 2500, UI_OBJECT_INFO);
    }
    lcdNeedsRefresh=true;
}

void cmd_stop()           { mega_cmd(":Q",false); m_isTracking=false; m_isSlewing=false; }
void cmd_toggleTracking() {
    if(m_isTracking) mega_cmd(":Td",false);
    else             mega_cmd(":Te",false);
}

void cmd_setSpeed(double s){
    int nnn = (int)(s*10);
    if(nnn < 5)  nnn = 5;
    if(nnn > 40) nnn = 40;
    String c = ":BV "; c += String(nnn);
    mega_cmd(c);
    m_slewSpeed = nnn / 10.0;
}

void cmd_parking()         { mega_cmd(":hP"); }
void cmd_sync()            { mega_cmd(":CM"); }

void showMessage(const char* line0, const char* line1, unsigned long ms, int returnTo) {
    snprintf(uiMsgL0, 21, "%-20s", line0);
    snprintf(uiMsgL1, 21, "%-20s", line1);
    uiMsgUntil  = millis() + ms;
    uiMsgReturn = returnTo;
    uiState     = UI_MESSAGE;
    lcdNeedsRefresh = true;
}

// [v6.3] Synchronisation GPS automatique avant edition menu

float current_lst = -1.0;
unsigned long lst_sync_millis = 0;

float getCurrentLST() {
    if (current_lst < 0) return -1.0;
    float elapsed_h = (millis() - lst_sync_millis) * 1.0027379 / 3600000.0;
    float lst = current_lst + elapsed_h;
    while (lst >= 24.0) lst -= 24.0;
    return lst;
}

bool isVisible(float ra_h, float dec_deg) {
    float lst = getCurrentLST();
    if (lst < 0) return true; // Si pas d'heure siderale, on suppose visible
    float ha_h = lst - ra_h;
    float ha_rad = ha_h * 15.0 * (PI / 180.0);
    float dec_rad = dec_deg * (PI / 180.0);
    float lat_rad = obs_lat * (PI / 180.0);
    
    float sin_alt = sin(dec_rad)*sin(lat_rad) + cos(dec_rad)*cos(lat_rad)*cos(ha_rad);
    float alt_rad = asin(sin_alt);
    float alt_deg = alt_rad * (180.0 / PI);
    return alt_deg > 10.0;
}

void syncDataFromMega() {
    String gt = mega_cmd(":GL#");
    String gc = mega_cmd(":GC#");
    String glat = mega_cmd(":Gt#");
    String glon = mega_cmd(":Gg#");

    String gs = mega_cmd(":GS#");

    if(gt.length() >= 8 && gc.length() >= 8) {
        dt_hr = gt.substring(0,2).toInt();
        dt_min = gt.substring(3,5).toInt();
        dt_sec = gt.substring(6,8).toInt();
        dt_m = gc.substring(0,2).toInt();
        dt_d = gc.substring(3,5).toInt();
        dt_y = 2000 + gc.substring(6,8).toInt();
    }
    if(glat.length() >= 6) {
        float sign = (glat.charAt(0) == '-') ? -1.0 : 1.0;
        float deg = glat.substring(1,3).toFloat();
        float mn = glat.substring(4,6).toFloat();
        obs_lat = sign * (deg + mn/60.0);
    }
    if(glon.length() >= 7) {
        float sign = (glon.charAt(0) == '-') ? -1.0 : 1.0;
        float deg = glon.substring(1,4).toFloat();
        float mn = glon.substring(5,7).toFloat();
        // Protocole OnStep : '-' = EST positif local
        obs_lon = (sign < 0) ? (deg + mn/60.0) : -(deg + mn/60.0);
    }
    if(gs.length() >= 8) {
        float h = gs.substring(0,2).toFloat();
        float m = gs.substring(3,5).toFloat();
        float s = gs.substring(6,8).toFloat();
        current_lst = h + m/60.0 + s/3600.0;
        lst_sync_millis = millis();
    }
}

// ============================================================
// SECTION 9 : ACCÈS CATALOGUES
// ============================================================
uint32_t getCatalogCount(CatID c){
    switch(c){
        case CAT_MESSIER:  return MESSIER_COUNT;
        case CAT_NGC:      return NGC_COUNT;
        case CAT_IC:       return IC_COUNT;
        case CAT_PK:       return PK_COUNT;
        case CAT_CALDWELL: return CALDWELL_COUNT;
        case CAT_BSC:      return BSC_COUNT;
        case CAT_SYSSOL:
            if(!timeFetched) { syncDataFromMega(); timeFetched = true; }
            computeSysSol(dt_y, dt_m, dt_d, dt_hr, dt_min, dt_sec);
            return SYSSOL_COUNT;
        default: return 0;
    }
}

bool getObj(CatID c, uint32_t i, DeepSkyObject &out){
    if(c==CAT_BSC) return false;
    switch(c){
        case CAT_MESSIER:  out=getObjectFromCatalog(catalogM,        i); return true;
        case CAT_NGC:      out=getObjectFromCatalog(catalogNGC,      i); return true;
        case CAT_IC:       out=getObjectFromCatalog(catalogIC,       i); return true;
        case CAT_PK:       out=getObjectFromCatalog(catalogPK,       i); return true;
        case CAT_CALDWELL: out=getObjectFromCatalog(catalogCaldwell, i); return true;
        default: return false;
    }
}

const char* getCatPrefix(CatID c){
    switch(c){
        case CAT_MESSIER:  return "M";
        case CAT_NGC:      return "NGC";
        case CAT_IC:       return "IC";
        case CAT_PK:       return "PK";
        case CAT_CALDWELL: return "C";
        case CAT_BSC:      return "*";
        default: return "?";
    }
}

void selectCurrentObject(){
    if(currentCat == CAT_SYSSOL) {
        selectedIsStar = false;
        selectedObj.id = objectIndex;
        selectedObj.ra = sysSolObjs[objectIndex].ra;
        selectedObj.dec = sysSolObjs[objectIndex].dec;
        selectedObj.mag = 0;
        selectedObj.type = 255;
        return;
    }
    if(currentCat==CAT_BSC){
        selectedStar=getStarFromCatalog(objectIndex);
        selectedIsStar=true;
    } else {
        getObj(currentCat,objectIndex,selectedObj);
        selectedIsStar=false;
    }
}

// ============================================================
// SECTION 10 : AFFICHAGE LCD
// ============================================================
void lcdLine(uint8_t row, const char* str){
    if (row >= 4) return;
    lcd.setCursor(0,row);
    char buf[21]; snprintf(buf,21,"%-20s",str);
    lcd.print(buf);
}

void printMain(){
    char buf[21];
    
    if (mountType == 0 && !displayRaDec) {
        long az_sec = round(fabs(m_currentAz) * 3600.0);
        int az_d = az_sec / 3600;
        int az_m = (az_sec % 3600) / 60;
        int az_s = az_sec % 60;
        
        bool alt_neg = (m_currentAlt < 0);
        long alt_sec = round(fabs(m_currentAlt) * 3600.0);
        int alt_d = alt_sec / 3600;
        int alt_m = (alt_sec % 3600) / 60;
        int alt_s = alt_sec % 60;

        snprintf(buf,21,"AZ: %03d%c%02d'%02d\"", az_d, 0xDF, az_m, az_s);
        lcdLine(0,buf);
        snprintf(buf,21,"ALT: %c%02d%c%02d'%02d\"", alt_neg?'-':'+', alt_d, 0xDF, alt_m, alt_s);
        lcdLine(1,buf);
    } else {
        bool dneg=(m_currentDEC<0); double adec=fabs(m_currentDEC);
        int dd=(int)adec, dm=(int)((adec-dd)*60.0), ds=(int)(((adec-dd)*60.0-dm)*60.0);
        int rh=(int)m_currentRA, rm=(int)((m_currentRA-rh)*60.0), rs=(int)(((m_currentRA-rh)*60.0-rm)*60.0);

        snprintf(buf,21,"RA: %02dh%02dm%02ds", rh, rm, rs);
        lcdLine(0,buf);
        snprintf(buf,21,"DEC: %c%02d%c%02d'%02d\"", dneg?'-':'+', dd, 0xDF, dm, ds);
        lcdLine(1,buf);
    }
    
    if(!m_online){
        lcdLine(2, isEnglish ? "STATE: NO CONNECTION" : "Etat: Non connectee");
    } else if(m_isPaused){
        lcdLine(2, "* EN PAUSE *");
    } else if(m_limitHit){
        lcdLine(2, "!! LIMITE !!");
    } else {
        const char* mnt_str = (mountType == 0) ? "ALTAZ" : ((mountType == 1) ? "FORK EQ" : "GERM EQ");
        snprintf(buf, 21,"ETAT: %s %c %s", 
                 mnt_str,
                 m_isTracking?(char)CHAR_CHECK:'-',
                 m_isSlewing?"GOTO":"OK");
        lcdLine(2,buf);
    }
    lcdLine(3, isEnglish ? "[ENT] = Menu        " : "[ENT] = Menu        ");
}

void printMessage(){
    lcd.clear();
    lcdLine(0, uiMsgL0);
    lcdLine(1, uiMsgL1);
}

const char* getCatName(int idx) {
    if (idx < 0 || idx >= CAT_COUNT) return "";
    if (isEnglish) {
        const char* const NAMES_EN[] = {
            "Messier", "NGC", "IC", "PK", "Caldwell", "Stars", "Sol"
        };
        return NAMES_EN[idx];
    }
    return CAT_NAMES[idx];
}

void printCatSelect(){
    lcdLine(0, isEnglish ? "[ SELECT CATALOG ]" : "[ CHOIX CATALOGUE ]");
    char buf[21];
    snprintf(buf, 21,"> %-15s", getCatName((int)currentCat));
    lcdLine(1,buf);
    snprintf(buf,21,"  (%lu obj)", getCatalogCount((CatID)currentCat));
    lcdLine(2,buf);
    lcdLine(3, isEnglish ? "  [UP/DWN] Select" : "  [HAUT/BAS] Choisir");
}

void printObjectList(){
    char buf[21];
    snprintf(buf, 21,"[%s] %lu obj", getCatName((int)currentCat), getCatalogCount((CatID)currentCat));
    lcdLine(0,buf);

    uint32_t total=getCatalogCount(currentCat);
    if(total==0){ 
        lcdLine(1," Aucun objet"); 
        lcdLine(2,"");
        lcdLine(3,"");
        return; 
    }

    char line[21];
    float mag = 0;
    double ra = 0, dec = 0;
    
    if(currentCat==CAT_BSC){
        StarObject s=getStarFromCatalog((uint32_t)objectIndex);
        char ast = isVisible(s.ra, s.dec) ? '*' : ' ';
        snprintf(line, 21,"> %s%c", s.name, ast);
        mag = s.mag/10.0f;
        ra = s.ra; dec = s.dec;
    } else if(currentCat==CAT_SYSSOL){
        char ast = isVisible(sysSolObjs[objectIndex].ra, sysSolObjs[objectIndex].dec) ? '*' : ' ';
        snprintf(line, 21,"> %s%c", sysSolObjs[objectIndex].name, ast);
        mag = 0; // Not available
        ra = sysSolObjs[objectIndex].ra; dec = sysSolObjs[objectIndex].dec;
    } else {
        DeepSkyObject o; getObj(currentCat,(uint32_t)objectIndex,o);
        char ast = isVisible(o.ra, o.dec) ? '*' : ' ';
        snprintf(line, 21,"> %s%d%c", getCatPrefix(currentCat), o.id, ast);
        mag = o.mag/10.0f;
        ra = o.ra; dec = o.dec;
    }
    lcdLine(1,line);
    
    if (currentCat!=CAT_SYSSOL) {
        snprintf(buf,21,"  Mag: %.1f", mag);
        lcdLine(2,buf);
    } else {
        lcdLine(2,"");
    }
    
    int rah=(int)ra;
    int ram=(int)((ra-rah)*60);
    int dd=(int)fabs(dec);
    snprintf(buf,21,"  %02dh%02d %c%02d%c", rah,ram, dec<0?'-':'+', dd, 0xDF);
    lcdLine(3,buf);
}

void printObjectInfo(){
    char buf[21];
    double ra = 0, dec = 0;
    
    if (currentCat == CAT_SYSSOL) {
        char ast = isVisible(sysSolObjs[objectIndex].ra, sysSolObjs[objectIndex].dec) ? '*' : ' ';
        snprintf(buf,21,"OBJET: %s%c",sysSolObjs[objectIndex].name, ast);
        ra = sysSolObjs[objectIndex].ra; dec = sysSolObjs[objectIndex].dec;
    } else if(selectedIsStar){
        char ast = isVisible(selectedStar.ra, selectedStar.dec) ? '*' : ' ';
        snprintf(buf,21,"OBJET: %s%c",selectedStar.name, ast);
        ra = selectedStar.ra; dec = selectedStar.dec;
    } else {
        char ast = isVisible(selectedObj.ra, selectedObj.dec) ? '*' : ' ';
        snprintf(buf,21,"OBJET: %s%d%c", getCatPrefix(currentCat), selectedObj.id, ast);
        ra = selectedObj.ra; dec = selectedObj.dec;
    }
    lcdLine(0,buf);
    
    int rah=(int)ra, ram=(int)((ra-rah)*60);
    snprintf(buf,21,"RA: %02dh%02dm", rah,ram);
    lcdLine(1,buf);
    
    int dd=(int)fabs(dec), dm=(int)((fabs(dec)-dd)*60);
    snprintf(buf,21,"DEC: %c%02d%c%02d'", dec<0?'-':'+', dd, 0xDF, dm);
    lcdLine(2,buf);
    
    lcdLine(3, "[ENT]=GOTO [>]=SYNC");
}

void printSlewing(){
    char anim_chars[] = {'*', '+', 'x', '+'};
    char anim = anim_chars[(millis() / 250) % 4];
    char b0[21];
    
    if (isParkingWorkflow) {
        snprintf(b0, 21, isEnglish ? "PARKING IN PROG %c" : "PARKING EN COURS %c", anim);
        lcdLine(0, b0);
        lcdLine(1, isEnglish ? "Motors running..." : "Moteurs en route...");
        lcdLine(2, isEnglish ? "Please wait" : "Veuillez patienter");
        lcdLine(3, isEnglish ? "[<] Cancel" : "[<] Annuler");
    } else {
        snprintf(b0, 21, isEnglish ? "SLEWING TO TGT %c" : "GOTO EN COURS... %c", anim);
        lcdLine(0, b0);
        
        double ra  = selectedIsStar?selectedStar.ra  :selectedObj.ra;
        double dec = selectedIsStar?selectedStar.dec :selectedObj.dec;
        double c_dec_rad = m_currentDEC * DEGRAD;
        double t_dec_rad = dec * DEGRAD;
        double d_ra_rad = (m_currentRA - ra) * 15.0 * DEGRAD;
        double cos_dist = sin(c_dec_rad) * sin(t_dec_rad) + cos(c_dec_rad) * cos(t_dec_rad) * cos(d_ra_rad);
        if (cos_dist < -1.0) cos_dist = -1.0;
        if (cos_dist > 1.0) cos_dist = 1.0;
        double dist = acos(cos_dist) * RADEG;
        double speed = m_slewSpeed;
        if (speed < 0.05) speed = 3.0;
        int eta = (int)(dist / speed);

        char buf[21];
        snprintf(buf, 21, "Dist restante: %.1f%c", dist, 0xDF);
        lcdLine(1, buf);
        snprintf(buf, 21, "Temps estime:  %ds", eta);
        lcdLine(2, buf);
        lcdLine(3, isEnglish ? "[<] Cancel GOTO" : "[<] Annuler GOTO");
    }
}

void printSpeed(){
    char buf[21];
    lcdLine(0, isEnglish ? "[ GOTO SPEED ]" : "[ VITESSE GOTO ]");
    snprintf(buf, 21," > %.1f deg/s", temp_slewSpeed);
    lcdLine(1,buf);
    lcdLine(2,"");
    lcdLine(3, isEnglish ? "[UP/DWN] Edit" : "[HAUT/BAS] Edit");
}

void printSettings() {
    lcdLine(0, isEnglish ? "[ SETTINGS ]" : "[ REGLAGES ]");
    const char* opts[] = {
        "Catalogues",
        m_isPaused ? (isEnglish ? "Resume Track" : "Reprendre Suivi") : (isEnglish ? "Pause Motors" : "Pause Moteurs"),
        isEnglish ? "GoTo Speed" : "Vitesse GoTo", 
        "Buzzer", 
        isEnglish ? "Sync/Align" : "Synchroniser", 
        isEnglish ? "Parking" : "Parking", 
        isEnglish ? "Mount Type" : "Type Monture",
        (mountType == 0) ? "Ratio AZ" : "Ratio RA",
        (mountType == 0) ? "Ratio ALT" : "Ratio DEC",
        isEnglish ? "Motor Power" : "Alim Moteurs", 
        isEnglish ? "Date/Time" : "Date/Heure", 
        isEnglish ? "Location" : "Lieu Obs.", 
        isEnglish ? "Language" : "Langue",
        "GPS Auto",
        isEnglish ? "Coord Display" : "Affichage Coord"
    };
    
    char b1[21], b2[21], b3[21];
    int start = settingsSel;
    if (start > 15 - 3) start = 15 - 3;
    
    snprintf(b1, 21, "%c %s", (settingsSel == start) ? '>' : ' ', opts[start]);
    snprintf(b2, 21, "%c %s", (settingsSel == start + 1) ? '>' : ' ', opts[start + 1]);
    snprintf(b3, 21, "%c %s", (settingsSel == start + 2) ? '>' : ' ', opts[start + 2]);
    
    lcdLine(1, b1);
    lcdLine(2, b2);
    lcdLine(3, b3);
}

void printAlignCenter(){
    char buf[21];
    if (selectedIsStar) {
        snprintf(buf, 21, isEnglish ? "Center %s" : "Centrez %s", selectedStar.name);
    } else {
        snprintf(buf, 21, isEnglish ? "Center %s%d" : "Centrez %s%d", getCatPrefix(currentCat), selectedObj.id);
    }
    lcdLine(0, buf);
    lcdLine(1, "   ENT=SYNC     ");
    lcdLine(2, "");
    lcdLine(3, "");
}

void printAlign(){
    lcdLine(0, "SYNCHRONISATION");
    lcdLine(1, "ENT=OK  <=RET");
    lcdLine(2, "");
    lcdLine(3, "");
}

void printParking(){
    lcdLine(0, "PARKING");
    lcdLine(1, "ENT=OK  <=RET");
    lcdLine(2, "");
    lcdLine(3, "");
}

void sendLocationToMega() {
    char buf[16];
    int lat_deg = abs(obs_lat);
    int lat_min = (abs(obs_lat) - lat_deg) * 60;
    snprintf(buf, 16, ":St%c%02d*%02d", obs_lat>=0?'+':'-', lat_deg, lat_min);
    mega_cmd(buf);
    int lon_deg = abs(obs_lon);
    int lon_min = (abs(obs_lon) - lon_deg) * 60;
    snprintf(buf, 16, ":Sg%c%03d*%02d", obs_lon>=0?'+':'-', lon_deg, lon_min);
    mega_cmd(buf);
}

void refreshLcd(){
    // LCD I2C standard (pas de gestion couleur RGB)
    switch(uiState){
        case UI_MAIN:        printMain();       break;
        case UI_CAT_SELECT:  printCatSelect();  break;
        case UI_OBJECT_LIST: printObjectList(); break;
        case UI_OBJECT_INFO: printObjectInfo(); break;
        case UI_SLEWING:     printSlewing();    break;
        case UI_SPEED:       printSpeed();      break;
        case UI_SETTINGS:    printSettings();   break;
        case UI_ALIGN:       printAlign();      break;
        case UI_ALIGN_CENTER:printAlignCenter();break;
        case UI_PARKING:     printParking();    break;
        case UI_MESSAGE:     printMessage();    break;
        
        case UI_MOUNT: {
            lcdLine(0, "[ TYPE MONTURE ]");
            lcdLine(1, temp_mountType == 0 ? "> AltAz         " : "  AltAz         ");
            lcdLine(2, temp_mountType == 1 ? "> ForkEq        " : "  ForkEq        ");
            lcdLine(3, temp_mountType == 2 ? "> GermanEq      " : "  GermanEq      ");
            break;
        }
        case UI_RATIO_AZ: {
            lcdLine(0, "[ RATIO AZ/RA ]");
            char buf[21]; snprintf(buf, 21,">%.1f", temp_gearRatioAZ);
            lcdLine(1, buf);
            lcdLine(2, "");
            lcdLine(3, isEnglish ? "[UP/DWN] Edit" : "[HAUT/BAS] Edit");
            break;
        }
        case UI_RATIO_ALT: {
            lcdLine(0, "[ RATIO DEC/AL ]");
            char buf[21]; snprintf(buf, 21,">%.1f", temp_gearRatioALT);
            lcdLine(1, buf);
            lcdLine(2, "");
            lcdLine(3, isEnglish ? "[UP/DWN] Edit" : "[HAUT/BAS] Edit");
            break;
        }
        case UI_BEEP: {
            lcdLine(0, "[ REGLAGE BIP ]");
            lcdLine(1, temp_buzzerOn ? "> ACTIF         " : "  ACTIF         ");
            lcdLine(2, temp_buzzerOn ? "  INACTIF       " : "> INACTIF       ");
            lcdLine(3, isEnglish ? "[UP/DWN] Select" : "[HAUT/BAS] Choisir");
            break;
        }
        case UI_EDIT_TIME: {
            lcdLine(0, "[ HEURE ]");
            char b[17];
            snprintf(b,17,"%02d/%02d %02d:%02d", dt_d, dt_m, dt_hr, dt_min);
            lcdLine(1,b);
            lcdLine(2, "");
            lcdLine(3, isEnglish ? "[UP/DWN] Edit" : "[HAUT/BAS] Edit");
            break;
        }
        case UI_EDIT_LOCATION: {
            lcdLine(0, "[ LIEU ]");
            char b[17];
            snprintf(b,17,"La:%.1f Lo:%.1f", obs_lat, obs_lon);
            lcdLine(1,b);
            lcdLine(2, "");
            lcdLine(3, isEnglish ? "[UP/DWN] Edit" : "[HAUT/BAS] Edit");
            break;
        }
        case UI_MOTOR_POWER: {
            lcdLine(0, "[ ALIM MOTEURS ]");
            lcdLine(1, temp_motorPowerOn ? "> ACTIVE        " : "  ACTIVE        ");
            lcdLine(2, temp_motorPowerOn ? "  DESACTIVE     " : "> DESACTIVE     ");
            lcdLine(3, "[HAUT/BAS] Choisir");
            break;
        }
        case UI_LANGUAGE: {
            lcdLine(0, isEnglish ? "[ LANGUAGE ]" : "[ LANGUE ]");
            lcdLine(1, temp_isEnglish ? "> English       " : "  English       ");
            lcdLine(2, temp_isEnglish ? "  Francais      " : "> Francais      ");
            lcdLine(3, temp_isEnglish ? "[UP/DWN] Select" : "[HAUT/BAS] Choisir");
            break;
        }
        case UI_GPS: {
            lcdLine(0, "[ GPS ]");
            lcdLine(1, temp_gpsEnabled ? (isEnglish ? "> Auto enabled  " : "> Auto active   ") : (isEnglish ? "  Auto enabled  " : "  Auto active   "));
            lcdLine(2, temp_gpsEnabled ? (isEnglish ? "  Disabled      " : "  Desactive     ") : (isEnglish ? "> Disabled      " : "> Desactive     "));
            lcdLine(3, isEnglish ? "[UP/DWN] Select" : "[HAUT/BAS] Choisir");
            break;
        }
        case UI_COORD_MODE: {
            lcdLine(0, isEnglish ? "[ COORD MODE ]" : "[ AFFICHAGE ]");
            lcdLine(1, temp_displayRaDec ? "> RA/DEC        " : "  RA/DEC        ");
            lcdLine(2, temp_displayRaDec ? "  ALT/AZ        " : "> ALT/AZ        ");
            lcdLine(3, isEnglish ? "[UP/DWN] Select" : "[HAUT/BAS] Choisir");
            break;
        }
        case UI_MENU_SELECT: {
            lcdLine(0, "[ MENU ]");
            const char* opt0 = "Catalogues";
            const char* opt1 = m_isPaused ? "Reprendre Suivi" : "Pause Moteurs";
            const char* opt2 = "Reglages";
            
            char b1[21], b2[21], b3[21];
            snprintf(b1, 21, "%c %s", (menuSel == 0) ? '>' : ' ', opt0);
            snprintf(b2, 21, "%c %s", (menuSel == 1) ? '>' : ' ', opt1);
            snprintf(b3, 21, "%c %s", (menuSel == 2) ? '>' : ' ', opt2);
            
            lcdLine(1, b1);
            lcdLine(2, b2);
            lcdLine(3, b3);
            break;
        }
        default: break;
    }
    lcdNeedsRefresh=false;
}

void readButtons(){
    unsigned long now=millis();
    for(int i=0;i<5;i++){
        bool raw=(digitalRead(BTN_PINS[i])==LOW);
        if(raw!=btnPrev[i]) btnTime[i]=now;
        bool newState=(now-btnTime[i]>DEBOUNCE_MS)?raw:btnState[i];
        if(newState && !btnState[i]) btnHoldTime[i]=now;
        btnState[i]=newState;
        btnPrev[i]=raw;
    }
}

void detectPresses(){
    for(int i=0;i<5;i++){
        btnPressed[i]=(btnState[i]&&!btnWas[i]);
        btnWas[i]=btnState[i];
    }
}

int fastScroll(int btnIdx, int dir){
    if(btnState[btnIdx] && millis()-btnHoldTime[btnIdx] > 600){
        static unsigned long lastFast=0;
        if(millis()-lastFast > FAST_SCROLL_DELAY){
            lastFast=millis();
            return dir * FAST_SCROLL_STEP;
        }
        return 0;
    }
    return btnPressed[btnIdx] ? dir : 0;
}

void scrollList(int delta){
    uint32_t total=getCatalogCount(currentCat);
    if(total==0) return;
    long newIdx=(long)objectIndex+delta;
    if(newIdx<0) newIdx=0;
    if((uint32_t)newIdx>=total) newIdx=total-1;
    objectIndex=(uint32_t)newIdx;
}

void handleButtons(){
    readButtons(); detectPresses();
    bool up    =btnPressed[BTN_IDX_UP];
    bool down  =btnPressed[BTN_IDX_DOWN];
    bool left  =btnPressed[BTN_IDX_LEFT];
    bool right =btnPressed[BTN_IDX_RIGHT];
    bool enter =btnPressed[BTN_IDX_ENTER];

    if(uiState == UI_MAIN) {
        for(int i=0; i<5; i++) {
            if(i != BTN_IDX_ENTER) {
                if(!btnState[i] && btnWas[i]) {
                    mega_cmd(":Q", false);
                }
            }
        }
    }

    int scrollDelta=0;
    if(uiState==UI_OBJECT_LIST){
        scrollDelta+=fastScroll(BTN_IDX_UP,   -1);
        scrollDelta+=fastScroll(BTN_IDX_DOWN, +1);
    }
    if(scrollDelta!=0){ 
        scrollList(scrollDelta); 
        lcdNeedsRefresh=true; 
        extern unsigned long lastLcd;
        lastLcd = 0;
        return; 
    }

    if(!up&&!down&&!left&&!right&&!enter) return;
    lcdNeedsRefresh=true;
    extern unsigned long lastLcd;
    lastLcd = 0; // Force immediate refresh

    switch(uiState){

        case UI_MAIN:
            if(up)    { mega_cmd(":Mn", false); }
            if(down)  { mega_cmd(":Ms", false); }
            if(left)  { mega_cmd(":Me", false); }
            if(right) { mega_cmd(":Mw", false); }
            if(enter) { settingsSel=0; uiState=UI_SETTINGS; }
            break;

        case UI_MENU_SELECT:
            // Obsolete state, kept to avoid compilation errors if referenced elsewhere
            uiState=UI_MAIN;
            break;

        case UI_CAT_SELECT:
            if(up)         { currentCat=(CatID)(((int)currentCat-1+CAT_COUNT)%CAT_COUNT); objectIndex=0; }
            if(down)       { currentCat=(CatID)(((int)currentCat+1)%CAT_COUNT); objectIndex=0; }
            if(left)       { uiState=UI_MENU_SELECT; }
            if(right||enter){ uiState=UI_OBJECT_LIST; objectIndex=0; }
            break;

        case UI_OBJECT_LIST:
            if(up)         { scrollList(-1); }
            if(down)       { scrollList(+1); }
            if(left)       { uiState=UI_CAT_SELECT; }
            if(right||enter){ selectCurrentObject(); uiState=UI_OBJECT_INFO; }
            break;

        case UI_OBJECT_INFO: {
            uint32_t total=getCatalogCount(currentCat);
            if(left)  { uiState=UI_OBJECT_LIST; isAlignWorkflow = false; }
            if(up)    { if(objectIndex>0) objectIndex--; else objectIndex=total-1;
                        selectCurrentObject(); }
            if(down)  { objectIndex=(objectIndex<total-1)?objectIndex+1:0;
                        selectCurrentObject(); }
            if(right) {
                double ra =selectedIsStar?selectedStar.ra  :selectedObj.ra;
                double dec=selectedIsStar?selectedStar.dec :selectedObj.dec;
                if (!isVisible(ra, dec)) {
                    showMessage(isEnglish ? " BELOW HORIZON! " : " SOUS HORIZON ! ", "                ", 2000, UI_OBJECT_INFO);
                    return;
                }
                char buf[16];
                int hr=(int)ra, mn=(int)((ra-hr)*60), sc=(int)((ra-hr-mn/60.0)*3600);
                snprintf(buf,16,":Sr%02d:%02d:%02d#",hr,mn,sc); mega_cmd(buf);
                bool n=dec<0; double d=abs(dec);
                int deg=(int)d; mn=(int)((d-deg)*60); sc=(int)((d-deg-mn/60.0)*3600);
                snprintf(buf,16,":Sd%c%02d*%02d:%02d#",n?'-':'+',deg,mn,sc); mega_cmd(buf);
                mega_cmd(":CM#");
                showMessage(isEnglish ? "  SYNCHRONIZED  " : "  SYNCHRONISE   ", "                ", 1500, UI_MAIN);
            }
            if(enter) {
                double ra =selectedIsStar?selectedStar.ra  :selectedObj.ra;
                double dec=selectedIsStar?selectedStar.dec :selectedObj.dec;
                if (!isVisible(ra, dec)) {
                    showMessage(isEnglish ? " BELOW HORIZON! " : " SOUS HORIZON ! ", "                ", 2000, UI_OBJECT_INFO);
                    return;
                }
                cmd_goto(ra,dec);
                if (isAlignWorkflow) {
                    uiState = UI_ALIGN_CENTER;
                }
            }
            break;
        }

        case UI_SLEWING:
            if(enter||left){ cmd_stop(); uiState=UI_MAIN; isParkingWorkflow=false; }
            break;
        case UI_SETTINGS:
            if(left)       { mega_cmd(":Q", false); uiState=UI_MAIN; }
            if(up)         { settingsSel=(settingsSel-1+15)%15; }
            if(down)       { settingsSel=(settingsSel+1)%15; }
            if(right||enter){
                if(settingsSel==0) { mega_cmd(":Q", false); currentCat=CAT_MESSIER; objectIndex=0; uiState=UI_CAT_SELECT; }
                if(settingsSel==1) {
                    mega_cmd(":Q", false);
                    if (!m_isPaused) {
                        mega_cmd(":Td", false);
                        m_isPaused = true;
                        showMessage(isEnglish ? " MOTORS PAUSED  " : " MOTEURS EN PAUSE ", isEnglish ? "  Math preserved   " : "  Calculs gardes   ", 1500, UI_MAIN);
                    } else {
                        if (targetRA >= 0 && targetDEC >= -90) {
                            mega_cmd(":Sr" + formatRA(targetRA));
                            mega_cmd(":Sd" + formatDEC(targetDEC));
                            String resp = mega_cmd(":MS");
                            m_isPaused = false;
                            if (resp.startsWith("0")) {
                                showMessage(isEnglish ? " RESUMING TRACK " : " REPRISE SUIVI... ", isEnglish ? " Calc & Point. " : " Recalcul & Point. ", 1500, UI_SLEWING);
                            } else {
                                char buf[21]; snprintf(buf, 21, "%-20s", resp.c_str());
                                showMessage(isEnglish ? "  !! IMPOSSIBLE !!  " : "  !! IMPOSSIBLE !!  ", buf, 2500, UI_MAIN);
                            }
                        } else {
                            mega_cmd(":Te", false);
                            m_isPaused = false;
                            showMessage(isEnglish ? " RESUMING TRACK " : " REPRISE SUIVI... ", isEnglish ? "  No target...     " : "  Sans cible...    ", 1500, UI_MAIN);
                        }
                    }
                }
                if(settingsSel==2) { temp_slewSpeed = m_slewSpeed; uiState=UI_SPEED; }
                if(settingsSel==3) { temp_buzzerOn = buzzerOn; uiState=UI_BEEP; }
                if(settingsSel==4) uiState=UI_ALIGN;
                if(settingsSel==5) uiState=UI_PARKING;
                if(settingsSel==6) { temp_mountType = mountType; uiState=UI_MOUNT; }
                if(settingsSel==7) { temp_gearRatioAZ = gearRatioAZ; uiState=UI_RATIO_AZ; }
                if(settingsSel==8) { temp_gearRatioALT = gearRatioALT; uiState=UI_RATIO_ALT; }
                if(settingsSel==9) { temp_motorPowerOn = motorPowerOn; uiState=UI_MOTOR_POWER; }
                if(settingsSel==10) { syncDataFromMega(); editSel=0; uiState=UI_EDIT_TIME; }
                if(settingsSel==11) { syncDataFromMega(); editSel=0; uiState=UI_EDIT_LOCATION; }
                if(settingsSel==12) { temp_isEnglish = isEnglish; uiState=UI_LANGUAGE; }
                if(settingsSel==13) { temp_gpsEnabled = gpsEnabled; uiState=UI_GPS; }
                if(settingsSel==14) { temp_displayRaDec = displayRaDec; uiState=UI_COORD_MODE; }
            }
            break;

        case UI_SPEED:
            if(left)  { uiState=UI_SETTINGS; }
            if(up)    { temp_slewSpeed += 0.5; if(temp_slewSpeed>6.0) temp_slewSpeed=6.0; }
            if(down)  { temp_slewSpeed -= 0.5; if(temp_slewSpeed<0.5) temp_slewSpeed=0.5; }
            if(enter) {
                m_slewSpeed = temp_slewSpeed;
                cmd_setSpeed(m_slewSpeed);
                saveEEPROM();
                char buf[21]; snprintf(buf,21,"   %.1f deg/s OK   ",m_slewSpeed);
                showMessage("  VITESSE REGL.    ", buf, 1200, UI_SETTINGS);
            }
            break;

        case UI_ALIGN:
            {
                bool found = false;
                for (int i=0; i<BSC_COUNT; i++) {
                    StarObject s = getStarFromCatalog(i);
                    if (isVisible(s.ra, s.dec)) {
                        currentCat = CAT_BSC;
                        objectIndex = i;
                        selectCurrentObject();
                        isAlignWorkflow = true;
                        uiState = UI_OBJECT_INFO;
                        found = true;
                        break;
                    }
                }
                if (!found) {
                    showMessage(isEnglish ? " NO STAR FOUND  " : " AUCUNE ETOILE  ", " VISIBLE        ", 1500, UI_SETTINGS);
                }
            }
            break;
            
        case UI_ALIGN_CENTER:
            if(left)  { uiState=UI_MAIN; isAlignWorkflow = false; }
            if(enter) {
                double ra =selectedIsStar?selectedStar.ra  :selectedObj.ra;
                double dec=selectedIsStar?selectedStar.dec :selectedObj.dec;
                char buf[16];
                int hr=(int)ra, mn=(int)((ra-hr)*60), sc=(int)((ra-hr-mn/60.0)*3600);
                snprintf(buf,16,":Sr%02d:%02d:%02d#",hr,mn,sc); mega_cmd(buf);
                bool n=dec<0; double d=abs(dec);
                int deg=(int)d; mn=(int)((d-deg)*60); sc=(int)((d-deg-mn/60.0)*3600);
                snprintf(buf,16,":Sd%c%02d*%02d:%02d#",n?'-':'+',deg,mn,sc); mega_cmd(buf);
                mega_cmd(":CM#");
                showMessage(isEnglish ? "  SYNCHRONIZED  " : "  SYNCHRONISE   ", "                ", 1500, UI_MAIN);
                isAlignWorkflow = false;
            }
            break;

        case UI_PARKING:
            if(left)  { uiState=UI_SETTINGS; }
            if(enter) {
                cmd_parking();
                isParkingWorkflow = true;
                showMessage(" PARKING EN COURS..", "                    ",
                            1500, UI_SLEWING);
            }
            break;


        case UI_MOUNT:
            if(left)  { uiState=UI_SETTINGS; }
            if(up||down) {
                temp_mountType = (temp_mountType + 1) % 3;
            }
            if(enter) {
                if (temp_mountType == 0) Serial1.print(":BMa#");
                else if (temp_mountType == 1) Serial1.print(":BMe#");
                else Serial1.print(":BMg#");
                showMessage(" MONTURE REGLEE   ", "                    ", 1200, UI_SETTINGS);
            }
            break;
            
        case UI_RATIO_AZ:
            if(left)  { uiState=UI_SETTINGS; }
            if(up)    { temp_gearRatioAZ += 10; }
            if(down)  { temp_gearRatioAZ -= 10; if(temp_gearRatioAZ<10) temp_gearRatioAZ=10; }
            if(enter) {
                gearRatioAZ = temp_gearRatioAZ;
                Serial1.print(":BGa"); Serial1.print(gearRatioAZ); Serial1.print("#");
                saveEEPROM();
                showMessage((mountType == 0) ? " RATIO AZ REGLE   " : " RATIO RA REGLE   ", "                    ", 1200, UI_SETTINGS);
            }
            break;

        case UI_RATIO_ALT:
            if(left)  { uiState=UI_SETTINGS; }
            if(up)    { temp_gearRatioALT += 10; }
            if(down)  { temp_gearRatioALT -= 10; if(temp_gearRatioALT<10) temp_gearRatioALT=10; }
            if(enter) {
                gearRatioALT = temp_gearRatioALT;
                Serial1.print(":BGe"); Serial1.print(gearRatioALT); Serial1.print("#");
                saveEEPROM();
                showMessage((mountType == 0) ? " RATIO ALT REGLE  " : " RATIO DEC REGLE  ", "                    ", 1200, UI_SETTINGS);
            }
            break;

        case UI_BEEP:
            if(left)  { uiState=UI_SETTINGS; }
            if(up||down) {
                temp_buzzerOn = !temp_buzzerOn;
            }
            if(enter) {
                buzzerOn = temp_buzzerOn;
                if (buzzerOn) Serial1.print(":Bb1#"); else Serial1.print(":Bb0#");
                saveEEPROM();
                showMessage(" BUZZER REGLE     ", "                    ", 1200, UI_SETTINGS);
            }
            break;

        case UI_EDIT_TIME:
            if(left) {
                if(editSel > 0) editSel--;
                else uiState=UI_SETTINGS;
            }
            if(right) {
                if(editSel < 5) editSel++;
            }
            if(up) {
                if(editSel==0) { dt_d++; if(dt_d>31) dt_d=1; }
                if(editSel==1) { dt_m++; if(dt_m>12) dt_m=1; }
                if(editSel==2) { dt_y++; if(dt_y>2099) dt_y=2024; }
                if(editSel==3) { dt_hr++; if(dt_hr>23) dt_hr=0; }
                if(editSel==4) { dt_min++; if(dt_min>59) dt_min=0; }
                if(editSel==5) { dt_sec++; if(dt_sec>59) dt_sec=0; }
            }
            if(down) {
                if(editSel==0) { dt_d--; if(dt_d<1) dt_d=31; }
                if(editSel==1) { dt_m--; if(dt_m<1) dt_m=12; }
                if(editSel==2) { dt_y--; if(dt_y<2024) dt_y=2099; }
                if(editSel==3) { dt_hr--; if(dt_hr<0) dt_hr=23; }
                if(editSel==4) { dt_min--; if(dt_min<0) dt_min=59; }
                if(editSel==5) { dt_sec--; if(dt_sec<0) dt_sec=59; }
            }
            if(enter) {
                char b[32];
                snprintf(b,32,":SC%02d/%02d/%02d",dt_m,dt_d,dt_y%100); mega_cmd(b);
                snprintf(b,32,":SL%02d:%02d:%02d",dt_hr,dt_min,dt_sec); mega_cmd(b);
                timeFetched = true;
                showMessage("   HEURE SAUVEE   ", "", 1200, UI_SETTINGS);
            }
            break;

        case UI_EDIT_LOCATION:
            if(left) {
                if(editSel > 0) editSel--;
                else uiState=UI_SETTINGS;
            }
            if(right) {
                if(editSel < 1) editSel++;
            }
            if(up) {
                if(editSel==0) { obs_lat += 1.0; if(obs_lat>90.0) obs_lat=90.0; }
                if(editSel==1) { obs_lon += 1.0; if(obs_lon>180.0) obs_lon=180.0; }
            }
            if(down) {
                if(editSel==0) { obs_lat -= 1.0; if(obs_lat<-90.0) obs_lat=-90.0; }
                if(editSel==1) { obs_lon -= 1.0; if(obs_lon<-180.0) obs_lon=-180.0; }
            }
            if(enter) {
                saveEEPROM();
                sendLocationToMega();
                showMessage("  LIEU SAUVEGARDE ", "", 1200, UI_SETTINGS);
            }
            break;

        case UI_MOTOR_POWER:
            if(left)  { uiState=UI_SETTINGS; }
            if(up||down) {
                temp_motorPowerOn = !temp_motorPowerOn;
            }
            if(enter) {
                motorPowerOn = temp_motorPowerOn;
                if (motorPowerOn) {
                    Serial1.print(":ME#");
                    showMessage(isEnglish ? " MOTORS ENABLED " : " MOTEURS ACTIFS ", "                    ", 1200, UI_SETTINGS);
                } else {
                    Serial1.print(":MD#");
                    showMessage(isEnglish ? " MOTORS DISABLED" : " ALIM COUPEE    ", "                    ", 1200, UI_SETTINGS);
                }
            }
            break;

        case UI_LANGUAGE:
            if(left)  { uiState=UI_SETTINGS; }
            if(up||down) {
                temp_isEnglish = !temp_isEnglish;
            }
            if(enter||right) {
                isEnglish = temp_isEnglish;
                saveEEPROM();
                showMessage(isEnglish ? " LANGUAGE SAVED " : " LANGUE ENREG.  ", "                    ", 1200, UI_SETTINGS);
            }
            break;

        case UI_GPS:
            if(left)  { uiState=UI_SETTINGS; }
            if(up||down) {
                temp_gpsEnabled = !temp_gpsEnabled;
            }
            if(enter||right) {
                gpsEnabled = temp_gpsEnabled;
                Serial1.print(gpsEnabled ? ":bg1#" : ":bg0#");
                showMessage(" GPS REGLE        ", "                    ", 1200, UI_SETTINGS);
            }
            break;

        case UI_COORD_MODE:
            if(left)  { uiState=UI_SETTINGS; }
            if(up||down) {
                temp_displayRaDec = !temp_displayRaDec;
            }
            if(enter||right) {
                displayRaDec = temp_displayRaDec;
                saveEEPROM();
                showMessage(isEnglish ? " SAVED          " : " ENREGISTRE     ", "                    ", 1200, UI_SETTINGS);
            }
            break;

        case UI_MESSAGE:
            if(up||down||left||right||enter){
                uiState = (UIState)uiMsgReturn;
                uiMsgUntil = 0;
            }
            break;

        default: break;
    }
}

// ============================================================
// SECTION 12 : SETUP
// ============================================================
void setup(){
    loadEEPROM();

    Serial1.begin(MEGA_BAUD);
    delay(500);
    // :BMa# logic removed, wait for Mega
    Serial1.print(":BGa"); Serial1.print(gearRatioAZ); Serial1.print("#");
    Serial1.print(":BGe"); Serial1.print(gearRatioALT); Serial1.print("#");
    if (buzzerOn) Serial1.print(":Bb1#"); else Serial1.print(":Bb0#");
    Serial1.print(":BV "); Serial1.print((int)(m_slewSpeed * 10)); Serial1.print("#");

    for(int i=0;i<5;i++) pinMode(BTN_PINS[i],INPUT_PULLUP);

    Wire.begin();
    lcd.init();
    lcd.backlight();
    initCustomChars();

    lcd.clear();
    char buf[21];
    
    // Animation d'etoiles
    for(int i=0; i<20; i++) {
        char anim_buf1[21] = "                    ";
        char anim_buf2[21] = "                    ";
        anim_buf1[i] = '*';
        anim_buf2[19-i] = '*';
        lcdLine(0, anim_buf1);
        lcdLine(3, anim_buf2);
        delay(40);
    }
    
    lcdLine(1,"   * GoTo Mega *    ");
    lcdLine(2,"   Raquette v6.3    ");
    
    for(int i=19; i>=0; i--) {
        char anim_buf1[21] = "                    ";
        char anim_buf2[21] = "                    ";
        anim_buf1[i] = '*';
        anim_buf2[19-i] = '*';
        lcdLine(0, anim_buf1);
        lcdLine(3, anim_buf2);
        delay(40);
    }
    delay(500);
    
    lcdLine(0,"  Connexion serie...");
    snprintf(buf,21," M%d NGC%d IC%d C%d  ",
             MESSIER_COUNT, NGC_COUNT, IC_COUNT, CALDWELL_COUNT);
    lcdLine(3,buf);
    delay(1200);   

    for(int i=0;i<3;i++){
        String r=mega_cmd(":GVP");
        if(r.startsWith("On-Step") || r.startsWith("GotoMega") || r.startsWith("GoTo") || r.startsWith("goto")){
            m_online=true; break;
        }
        delay(600);
    }

    if(m_online){
        lcdLine(2,"  Monture OK !     ");
        String sv=mega_cmd(":Bv");
        if(sv.length()>0) m_slewSpeed=sv.toInt()/10.0;
        delay(900);
    } else {
        lcdLine(2,"  NON CONNECTEE    ");
        lcdLine(3,"  Verif cable/baud ");
        delay(3000);
    }

    lcd.clear();
    lcdNeedsRefresh=true;
}

// ============================================================
// SECTION 13 : LOOP
// ============================================================
unsigned long lastLcd = 0;

void loop(){

    handleButtons();

    if(uiState == UI_MESSAGE && millis() >= uiMsgUntil){
        uiState = (UIState)uiMsgReturn;
        lcdNeedsRefresh = true;
    }

    static unsigned long lastPoll=0;
    if(millis()-lastPoll >= POLL_INTERVAL_MS){
        pollMega();
        lastPoll=millis();

        if(uiState==UI_SLEWING && !m_isSlewing) {
            uiState=UI_MAIN;
            isParkingWorkflow = false;
        }
        lcdNeedsRefresh=true;
    }

    if(lcdNeedsRefresh && millis()-lastLcd>=200){
        refreshLcd();
        lastLcd=millis();
    }
}
